## conf/machine/mbmicro.conf
```bitbake
#@TYPE: Machine
#@NAME: Miraclebox
#@DESCRIPTION: Machine configuration for the Miraclebox Premium Micro

IMAGEDIR ?= "miraclebox/micro"

MKUBIFS_ARGS = "-m 2048 -e 126976 -c 8192"
UBINIZE_ARGS = "-m 2048 -p 128KiB"

MACHINE_FEATURES += "dvb-c ceryon-blindscan-dvbc ceryon-blindscan-dvbs"

CHIPSET = "bcm7362"

PREFERRED_VERSION_linux-ceryon = "4.0.1"
require conf/machine/include/ceryon-mipsel.inc
```

## conf/machine/mbmicrov2.conf
```bitbake
#@TYPE: Machine
#@NAME: Miraclebox
#@DESCRIPTION: Machine configuration for the Miraclebox Premium Micro v2

IMAGEDIR ?= "miraclebox/microv2"

MKUBIFS_ARGS = "-m 2048 -e 126976 -c 8192"
UBINIZE_ARGS = "-m 2048 -p 128KiB"

MACHINE_FEATURES += "wifi-kernel4-4 dvb-c ceryon-blindscan-dvbc ceryon-blindscan-dvbs"

CHIPSET = "bcm73625"

PREFERRED_VERSION_linux-ceryon = "4.10.12"
require conf/machine/include/ceryon-mipsel.inc
```

## conf/machine/mbtwinplus.conf
```bitbake
#@TYPE: Machine
#@NAME: Miraclebox
#@DESCRIPTION: Machine configuration for the Miraclebox Premium Twin+

IMAGEDIR ?= "miraclebox/twinplus"

MKUBIFS_ARGS = "-m 2048 -e 126976 -c 8192"
UBINIZE_ARGS = "-m 2048 -p 128KiB"

MACHINE_FEATURES += " dvb-c ci textlcd broadmedia-blindscan-dvbc"
OPENPLI_FEATURES += " ci"
DISTRO_FEATURES_remove = "x11 wayland directfb"

CHIPSET = "bcm7241"
FORCE_REBOOT_OPTION = "reboot"

PREFERRED_VERSION_linux-broadmedia = "4.1.24"
require conf/machine/include/broadmedia-mipsel.inc
```

## conf/machine/spycat.conf
```bitbake
#@TYPE: Machine
#@NAME: SPYCAT Spycat
#@DESCRIPTION: Machine configuration for the SPYCAT Spycat

CHIPSET = "bcm7362"

PREFERRED_VERSION_linux-spycat = "4.11"

KERNEL_IMAGETYPE = "vmlinux.gz"
KERNEL_CONSOLE = "ttyS0,115200n8"

KERNEL_MODULE_AUTOLOAD += "r8723bs"
KERNEL_MODULE_AUTOLOAD += "hci_uart"

MACHINE_FEATURES += "spycat textlcd dvb-c"
OPENPLI_FEATURES += " ci"

require conf/machine/include/spycat-mipsel.inc
```

## conf/machine/spycatminiplus.conf
```bitbake
#@TYPE: Machine
#@NAME: SPYCAT Spycatmini+
#@DESCRIPTION: Machine configuration for the SPYCAT Spycatmini+

CHIPSET = "bcm7362"

PREFERRED_VERSION_linux-spycat = "4.11"

KERNEL_IMAGETYPE = "vmlinux.gz"
KERNEL_CONSOLE = "ttyS0,115200n8"

KERNEL_MODULE_AUTOLOAD += "r8723bs"
KERNEL_MODULE_AUTOLOAD += "hci_uart"

MACHINE_FEATURES += "spycat h265 textlcd dvb-c 7segment"

require conf/machine/include/spycat-mipsel.inc
```

## conf/machine/viperslim.conf
```bitbake
#@TYPE: 
#@NAME: 
#@DESCRIPTION: 

MKUBIFS_ARGS = "-m 2048 -e 126976 -c 4096"
UBINIZE_ARGS = "-m 2048 -p 128KiB -s 2048"

MACHINE_FEATURES += "textlcd 7seg h265"
DISTRO_FEATURES_remove = "x11 wayland directfb"

CHIPSET = "bcm73625"
RCTYPE = "18"

FORCE = "yes"

require conf/machine/include/formuler-mips.inc
```

## conf/machine/xpeedc.conf
```bitbake
#@TYPE: Machine
#@NAME: xpeedc
#@DESCRIPTION: Machine configuration for the xpeedc

MACHINE_FEATURES += " wifi-kernel4-4 textlcd dvb-c nexttv-blindscan-dvbc"
DISTRO_FEATURES_remove = "x11 wayland directfb"

MKUBIFS_ARGS = "-m 2048 -e 126976 -c 8192"
UBINIZE_ARGS = "-m 2048 -p 128KiB"

CHIPSET = "bcm7362"

PREFERRED_VERSION_linux-nexttv = "4.4.8"
require conf/machine/include/nexttv-mipsel.inc
```
