## conf/machine/alphatriplehd.conf
```bitbake
#@TYPE: Machine
#@NAME: SAB Alpha Triple HD BOX 
#@DESCRIPTION: Machine configuration for the SAB Alphatriple

IMAGEDIR ?= "sab_alpha_triple"

MKUBIFS_ARGS = "-m 2048 -e 126976 -c 8192"
UBINIZE_ARGS = "-m 2048 -p 128KiB"

MACHINE_FEATURES += " dvb-c textlcd broadmedia-blindscan-dvbc"
OPENPLI_FEATURES += " ci"

CHIPSET = "bcm7241"
FORCE_REBOOT_OPTION = "reboot"

PREFERRED_VERSION_linux-broadmedia = "4.1.24"
require conf/machine/include/broadmedia-mipsel.inc
```

## conf/machine/et10000.conf
```bitbake
#@TYPE: Machine
#@NAME: et10000
#@DESCRIPTION: Machine configuration for the et10000

MACHINE_FEATURES += " wifi-kernel4-4 dvb-c transcoding v3d-nxpl"
OPENPLI_FEATURES += " ci kodi"
DISTRO_FEATURES_remove = "x11 wayland directfb"

MKUBIFS_ARGS = "-m 2048 -e 126976 -c 8192"
UBINIZE_ARGS = "-m 2048 -p 128KiB"

CHIPSET = "bcm7425"
RCTYPE = "9"

PREFERRED_VERSION_linux-et = "4.10.6"
require conf/machine/include/et-mipsel.inc
```

## conf/machine/et1x000.conf
```bitbake
#@TYPE: Machine
#@NAME: Galaxy Innovations ET11000
#@DESCRIPTION: Machine configuration for the Galaxy Innovations ET11000

MACHINE_FEATURES += " textlcd dvb-c nexttv-blindscan-dvbc mmc"
OPENPLI_FEATURES += " ci"
DISTRO_FEATURES_remove = "x11 wayland directfb"

CHIPSET = "bcm7251s"

PREFERRED_VERSION_linux-nexttv = "4.1.37"
require conf/machine/include/nexttv-arm.inc
```

## conf/machine/et4x00.conf
```bitbake
#@TYPE: Machine
#@NAME: et4000
#@DESCRIPTION: Machine configuration for the et4000

MKUBIFS_ARGS = "-m 2048 -e 126976 -c 4096"
UBINIZE_ARGS = "-m 2048 -p 128KiB"

DEFAULTTUNE = "mips32el-nf"

MACHINE_FEATURES += " wifi-kernel4-4"
DISTRO_FEATURES_remove = "x11 wayland directfb"

CHIPSET = "bcm7358"
RCTYPE = "13"

PREFERRED_VERSION_linux-et = "4.10.6"
require conf/machine/include/et-mipsel.inc
```

## conf/machine/et5x00.conf
```bitbake
#@TYPE: Machine
#@NAME: Xtrend et5x00
#@DESCRIPTION: Machine configuration for the Xtrend et5x00

MKUBIFS_ARGS = "-m 2048 -e 126976 -c 4096"
UBINIZE_ARGS = "-m 2048 -p 128KiB"

DEFAULTTUNE = "mips32el-nf"

MACHINE_FEATURES += " micom"
DISTRO_FEATURES_remove = "x11 wayland directfb"

CHIPSET = "bcm7413"
RCTYPE = "7"

PREFERRED_VERSION_linux-et = "3.8.7"
require conf/machine/include/et-mipsel.inc
```

## conf/machine/et6x00.conf
```bitbake
#@TYPE: Machine
#@NAME: Xtrend et6x00
#@DESCRIPTION: Machine configuration for the Xtrend et6x00

MKUBIFS_ARGS = "-m 2048 -e 126976 -c 4096"
UBINIZE_ARGS = "-m 2048 -p 128KiB"

DEFAULTTUNE = "mips32el-nf"

MACHINE_FEATURES += " micom textlcd 7segment"
DISTRO_FEATURES_remove = "x11 wayland directfb"

CHIPSET = "bcm7413"
RCTYPE = "9"

PREFERRED_VERSION_linux-et = "3.8.7"
require conf/machine/include/et-mipsel.inc
```

## conf/machine/et7000mini.conf
```bitbake
#@TYPE: Machine
#@NAME: Galaxy Innovations ET-7000 Mini
#@DESCRIPTION: Machine configuration for the Galaxy Innovations ET-7000 Mini

MACHINE_FEATURES += " textlcd dvb-c nexttv-blindscan-dvbc"
DISTRO_FEATURES_remove = "x11 wayland directfb"

MKUBIFS_ARGS = "-m 2048 -e 126976 -c 8192"
UBINIZE_ARGS = "-m 2048 -p 128KiB"

CHIPSET = "bcm7362"

PREFERRED_VERSION_linux-nexttv = "4.1.21"
require conf/machine/include/nexttv-mipsel.inc
```

## conf/machine/et7x00.conf
```bitbake
#@TYPE: Machine
#@NAME: et7000
#@DESCRIPTION: Machine configuration for the et7000

MACHINE_FEATURES += " wifi-kernel4-4 textlcd dvb-c nexttv-blindscan-dvbc"
OPENPLI_FEATURES += " ci"
DISTRO_FEATURES_remove = "x11 wayland directfb"

MKUBIFS_ARGS = "-m 2048 -e 126976 -c 8192"
UBINIZE_ARGS = "-m 2048 -p 128KiB"

CHIPSET = "bcm7362"

PREFERRED_VERSION_linux-nexttv = "4.4.8"
require conf/machine/include/nexttv-mipsel.inc
```

## conf/machine/et8000.conf
```bitbake
#@TYPE: Machine
#@NAME: et8000
#@DESCRIPTION: Machine configuration for the et8000

MACHINE_FEATURES += " wifi-kernel4-4 dvb-c transcoding"
OPENPLI_FEATURES += " ci"
DISTRO_FEATURES_remove = "x11 wayland directfb"

MKUBIFS_ARGS = "-m 2048 -e 126976 -c 8192"
UBINIZE_ARGS = "-m 2048 -p 128KiB"

CHIPSET = "bcm7241"
RCTYPE = "9"

PREFERRED_VERSION_linux-et = "4.10.6"
require conf/machine/include/et-mipsel.inc
```

## conf/machine/et8500.conf
```bitbake
#@TYPE: Machine
#@NAME: et8500
#@DESCRIPTION: Machine configuration for the et8500

MACHINE_FEATURES += " wifi-kernel4-4 dvb-c nexttv-blindscan-dvbc"
OPENPLI_FEATURES += " ci"
DISTRO_FEATURES_remove = "x11 wayland directfb"

MKUBIFS_ARGS = "-m 2048 -e 126976 -c 8192"
UBINIZE_ARGS = "-m 2048 -p 128KiB"

CHIPSET = "bcm7241"

PREFERRED_VERSION_linux-nexttv = "4.4.8"
require conf/machine/include/nexttv-mipsel.inc
```

## conf/machine/formuler4turbo.conf
```bitbake
#@TYPE: Machine
#@NAME: formuler f4turbo
#@DESCRIPTION: Machine configuration for the formuler f4turbo

MKUBIFS_ARGS = "-m 2048 -e 126976 -c 8192"
UBINIZE_ARGS = "-m 2048 -p 128KiB"

MACHINE_FEATURES += "textlcd 7seg dvb-c h265"
OPENPLI_FEATURES += " ci"
DISTRO_FEATURES_remove = "x11 wayland directfb"

CHIPSET = "bcm73625"
RCTYPE = "18"

require conf/machine/include/formuler-mipsel.inc
```

## conf/machine/include/ceryon-mipsel.inc
```bitbake
MACHINE_KERNEL_PR = "r0"

KERNEL_MODULE_AUTOLOAD += "xfs"

# We know about rtc
MACHINE_FEATURES_BACKFILL_CONSIDERED = "rtc"

IMAGE_CMD_ubi_prepend = " \
	rm -Rf ${IMAGE_ROOTFS}/tmp/*; \
	"

MACHINE_ESSENTIAL_EXTRA_RDEPENDS = "\
	${@bb.utils.contains("GST_VERSION", "1.0", "gstreamer1.0-libav", "gst-ffmpeg", d)} \
	ceryon-dvb-modules-${MACHINE} \
	kernel-vmlinux \
	"

MACHINE_EXTRA_RRECOMMENDS = " \
	gst-plugin-dvbmediasink \
	"

DVBMEDIASINK_CONFIG = "--with-wma --with-wmv --with-pcm --with-dts --with-eac3 \
    ${@bb.utils.contains('MACHINE', 'mbmicrov2', '--with-h265 --with-vb6 --with-vb8 --with-spark' , '', d)} \
"

TARGET_ARCH = "mipsel"
DEFAULTTUNE ?= "mips32el"

PREFERRED_PROVIDER_virtual/kernel = "linux-ceryon"

PREFERRED_PROVIDER_virtual/blindscan-dvbc = "ceryon-blindscan-utils-${MACHINE}"
PREFERRED_PROVIDER_virtual/blindscan-dvbs = "ceryon-blindscan-utils-${MACHINE}"

KERNEL_IMAGETYPE = "vmlinux"
KERNEL_OUTPUT = "${KERNEL_IMAGETYPE}"
KERNEL_OUTPUT_DIR = "."
KERNEL_CONSOLE = "null"
SERIAL_CONSOLE ?= ""

IMAGE_FSTYPES ?= "ubi"

UBI_VOLNAME = "rootfs"

IMGDEPLOYDIR ?= "${DEPLOY_DIR_IMAGE}"
IMAGEVERSION := "${DISTRO_NAME}-${DISTRO_VERSION}-${DATE}"
IMAGEVERSION[vardepsexclude] = "DATE"

IMAGE_CMD_ubi_append = " \
	mkdir -p ${IMGDEPLOYDIR}/${IMAGEDIR}; \
	cp ${IMGDEPLOYDIR}/${IMAGE_NAME}.rootfs.ubi ${IMGDEPLOYDIR}/${IMAGEDIR}/rootfs.bin; \
	gzip -9c ${DEPLOY_DIR_IMAGE}/vmlinux-${MACHINE}.bin > ${IMGDEPLOYDIR}/${IMAGEDIR}/kernel.bin; \
	echo "${IMAGEVERSION}" > ${IMGDEPLOYDIR}/${IMAGEDIR}/imageversion; \
	echo "rename this file to 'force' to force an update without confirmation" > ${IMGDEPLOYDIR}/${IMAGEDIR}/noforce; \
	cd ${IMGDEPLOYDIR}; \
	zip ${DISTRO_NAME}-${DISTRO_VERSION}-${MACHINE}_usb.zip ${IMAGEDIR}/*; \
	rm -Rf miraclebox; \
	"

IMAGE_CMD_ubi_prepend = " \
	rm -Rf ${IMAGE_ROOTFS}/tmp/*; \
	"

MACHINE_FEATURES += "alsa usbhost wlan 3dtv switchoff osdposition hdmicec dvbusb"

require conf/machine/include/tune-mips32.inc
require conf/machine/include/essential.inc
```

## conf/machine/include/essential.inc
```bitbake
MACHINE_EXTRA_RDEPENDS += "\
	${@bb.utils.contains('MACHINE_FEATURES', 'hbbtv', 'enigma2-plugin-extensions-hbbtv-${MACHINE}' , '', d)} \
	"

MACHINE_ESSENTIAL_EXTRA_RRECOMMENDS = "\
	kernel-module-cdfs \
	${@bb.utils.contains('MACHINE_FEATURES', 'v3d-nxpl', 'et-v3ddriver-${MACHINE}' , '', d)} \
	${@bb.utils.contains('MACHINE_FEATURES', 'micom', 'et-fpupdate-${MACHINE}' , '', d)} \
	${@bb.utils.contains('MACHINE_FEATURES', 'nexttv-blindscan-dvbc', 'nexttv-blindscanc-utils-${MACHINE}' , '', d)} \
	${@bb.utils.contains('MACHINE_FEATURES', 'ceryon-blindscan-dvbc', 'ceryon-blindscanc-utils-${MACHINE}' , '', d)} \
	${@bb.utils.contains('MACHINE_FEATURES', 'ceryon-blindscan-dvbs', 'ceryon-blindscans-utils-${MACHINE}' , '', d)} \
	${@bb.utils.contains('MACHINE_FEATURES', 'broadmedia-blindscan-dvbc', 'broadmedia-blindscanc-utils-${MACHINE}' , '', d)} \
	\
	firmware-carl9170 \
	firmware-rt2870 \
	firmware-rt73 \
	firmware-rtl8712u \
	firmware-rtl8192cu \
	firmware-htc7010 \
	firmware-htc9271 \
	firmware-zd1211 \
	\
	kernel-module-rtl88x2bu \
	\
	kernel-module-carl9170 \
	kernel-module-r8712u \
	kernel-module-r8723au \
	kernel-module-rt2500usb \
	kernel-module-rt2800usb \
	kernel-module-rt73usb \
	kernel-module-rtl8187 \
	kernel-module-rtl8192cu \
	kernel-module-zd1211rw \
	kernel-module-ath9k-htc \
	\
	${@bb.utils.contains('MACHINE_FEATURES', 'wifi-kernel4-4', 'firmware-rtl8192eu firmware-rtl8188eu firmware-rtl8xxxu firmware-mt7601u kernel-module-r8188eu kernel-module-8192eu kernel-module-mt7601u kernel-module-rtl8xxxu' , '', d)} \
	"
```

## conf/machine/include/et.inc
```bitbake
MACHINE_KERNEL_PR = "r0"

require conf/machine/include/essential.inc

KERNEL_MODULE_AUTOLOAD += "xfs"

# We know about rtc
MACHINE_FEATURES_BACKFILL_CONSIDERED = "rtc"

MACHINE_ESSENTIAL_EXTRA_RDEPENDS = " \
	et-dvb-modules-${MACHINE} \
	"

#Provider
PREFERRED_PROVIDER_virtual/egl ?= "et-v3ddriver-${MACHINE}"
PREFERRED_PROVIDER_virtual/libgles1 ?= "et-v3ddriver-${MACHINE}"
PREFERRED_PROVIDER_virtual/libgles2 ?= "et-v3ddriver-${MACHINE}"
PREFERRED_PROVIDER_virtual/libgbm ?= "et-v3ddriver-${MACHINE}"
PREFERRED_PROVIDER_virtual/libgl ?= "mesa"
PREFERRED_PROVIDER_virtual/mesa ?= "mesa"
PREFERRED_PROVIDER_virtual/kernel = "linux-et"

MACHINE_FEATURES += "alsa usbhost wlan 3dtv switchoff osdposition hdmicec"

MACHINE_EXTRA_RRECOMMENDS = " \
	gst-plugin-dvbmediasink \
	ntfs-3g \
	"

DVBMEDIASINK_CONFIG_mipsel = "--with-wma --with-wmv --with-pcm --with-dts --with-eac3 \
	${@bb.utils.contains('MACHINE_FEATURES', 'h265', '--with-h265 --with-vb6 --with-vb8 --with-spark' , '', d)} \
	"

EXTRA_OECONF_append_pn-kodi = " --with-gpu=v3d"
EXTRA_OECMAKE_append_pn-kodi += " -DWITH_V3D=nxpl"

IMAGEVERSION := "${DISTRO_NAME}-${DISTRO_VERSION}-${DATE}"
IMAGEVERSION[vardepsexclude] = "DATE"

IMAGEDIR ?= "${MACHINE}"
IMGDEPLOYDIR ?= "${DEPLOY_DIR_IMAGE}"

# MIPSEL
IMAGE_CMD_ubi_append_mipsel = " \
	mkdir -p ${IMGDEPLOYDIR}/${IMAGEDIR}; \
	cp ${IMGDEPLOYDIR}/${IMAGE_NAME}.rootfs.ubi ${IMGDEPLOYDIR}/${IMAGEDIR}/rootfs.bin; \
	cp ${DEPLOY_DIR_IMAGE}/vmlinux.gz-${MACHINE}.bin ${IMGDEPLOYDIR}/${IMAGEDIR}/kernel.bin; \
	echo "${IMAGEVERSION}" > ${IMGDEPLOYDIR}/${IMAGEDIR}/imageversion; \
	echo "rename this file to 'force' to force an update without confirmation" > ${IMGDEPLOYDIR}/${IMAGEDIR}/noforce; \
	cd ${IMGDEPLOYDIR}; \
	zip ${DISTRO_NAME}-${DISTRO_VERSION}-${MACHINE}_usb.zip ${IMAGEDIR}/*; \
	rm -Rf ${IMAGEDIR}; \
	rm -Rf ${IMGDEPLOYDIR}/boot; \
	"
```

## conf/machine/include/nexttv-arm.inc
```bitbake
IMAGE_FSTYPES ?= "tar.bz2"

TARGET_ARCH = "arm"
DEFAULTTUNE = "armv7ahf-neon"

MACHINE_KERNEL_PR = "r0"

require conf/machine/include/arm/arch-armv7a.inc
require conf/machine/include/essential.inc

KERNEL_MODULE_AUTOLOAD += "xfs"

# We know about rtc
MACHINE_FEATURES_BACKFILL_CONSIDERED = "rtc"

IMAGE_INSTALL_append += "\
    initrd-${MACHINE} \
    "

MACHINE_ESSENTIAL_EXTRA_RDEPENDS = "\
    nexttv-dvb-modules-${MACHINE} \
    "

#Provider
PREFERRED_PROVIDER_virtual/kernel = "linux-nexttv"

MACHINE_FEATURES += "alsa usbhost wlan 3dtv switchoff osdposition hdmicec"

MACHINE_EXTRA_RRECOMMENDS = " \
	gst-plugin-dvbmediasink \
	ntfs-3g \
	"

DVBMEDIASINK_CONFIG = "--with-h265 --with-vb8 --with-vb9 --with-wma --with-wmv --with-pcm --with-dts --with-eac3"

IMAGEVERSION := "${DISTRO_NAME}-${DISTRO_VERSION}-${DATE}"
IMAGEVERSION[vardepsexclude] = "DATE"

IMAGEDIR ?= "${MACHINE}"
IMGDEPLOYDIR ?= "${DEPLOY_DIR_IMAGE}"

IMAGE_CMD_tar_prepend = "\
    mkdir -p ${DEPLOY_DIR_IMAGE}/${IMAGEDIR}; \
    cp ${IMAGE_ROOTFS}/boot/update.bin ${DEPLOY_DIR_IMAGE}/${IMAGEDIR}/update.bin; \
    cp ${DEPLOY_DIR_IMAGE}/zImage ${DEPLOY_DIR_IMAGE}/${IMAGEDIR}/${KERNEL_FILE}; \
    echo ${IMAGEVERSION} > ${DEPLOY_DIR_IMAGE}/${IMAGEDIR}/imageversion; \
    echo "rename this file to 'force' to force an update without confirmation" > ${DEPLOY_DIR_IMAGE}/${IMAGEDIR}/noforce; \
    cd ${IMAGE_ROOTFS}; \
    tar -cvf ${DEPLOY_DIR_IMAGE}/rootfs.tar -C ${IMAGE_ROOTFS} .; \
    mv ${DEPLOY_DIR_IMAGE}/rootfs.tar ${DEPLOY_DIR_IMAGE}/${IMAGEDIR}/rootfs.tar; \
    bzip2 ${DEPLOY_DIR_IMAGE}/${IMAGEDIR}/rootfs.tar; \
    cd ${DEPLOY_DIR_IMAGE}; \
    zip ${IMAGE_NAME}_usb.zip ${IMAGEDIR}/*; \
    rm -f ${DEPLOY_DIR_IMAGE}/*.rootfs.tar.bz2; \
    rm -f ${DEPLOY_DIR_IMAGE}/.tar.bz2; \
    rm -f ${DEPLOY_DIR_IMAGE}/*.manifest; \
    rm -f ${DEPLOY_DIR_IMAGE}/.manifest; \
    rm -Rf ${IMAGEDIR}; \
"
```

## conf/machine/include/nexttv.inc
```bitbake
MACHINE_KERNEL_PR = "r0"

require conf/machine/include/essential.inc

KERNEL_MODULE_AUTOLOAD += "xfs"

# We know about rtc
MACHINE_FEATURES_BACKFILL_CONSIDERED = "rtc"

MACHINE_ESSENTIAL_EXTRA_RDEPENDS = " \
	nexttv-dvb-modules-${MACHINE} \
	"

#Provider
PREFERRED_PROVIDER_virtual/kernel = "linux-nexttv"

MACHINE_FEATURES += "alsa usbhost wlan 3dtv switchoff osdposition hdmicec"

MACHINE_EXTRA_RRECOMMENDS = " \
	gst-plugin-dvbmediasink \
	ntfs-3g \
	"

DVBMEDIASINK_CONFIG_mipsel = "--with-wma --with-wmv --with-pcm --with-dts --with-eac3 \
	${@bb.utils.contains('MACHINE_FEATURES', 'h265', '--with-h265 --with-vb6 --with-vb8 --with-spark' , '', d)} \
	"

IMAGEVERSION := "${DISTRO_NAME}-${DISTRO_VERSION}-${DATE}"
IMAGEVERSION[vardepsexclude] = "DATE"

IMAGEDIR ?= "${MACHINE}"
IMGDEPLOYDIR ?= "${DEPLOY_DIR_IMAGE}"

# MIPSEL
IMAGE_CMD_ubi_append_mipsel = " \
	mkdir -p ${IMGDEPLOYDIR}/${IMAGEDIR}; \
	cp ${IMGDEPLOYDIR}/${IMAGE_NAME}.rootfs.ubi ${IMGDEPLOYDIR}/${IMAGEDIR}/rootfs.bin; \
	cp ${DEPLOY_DIR_IMAGE}/vmlinux-${MACHINE}.bin ${IMGDEPLOYDIR}/${IMAGEDIR}/kernel.bin; \
	echo "${IMAGEVERSION}" > ${IMGDEPLOYDIR}/${IMAGEDIR}/imageversion; \
	echo "rename this file to 'force' to force an update without confirmation" > ${IMGDEPLOYDIR}/${IMAGEDIR}/noforce; \
	cd ${IMGDEPLOYDIR}; \
	zip ${DISTRO_NAME}-${DISTRO_VERSION}-${MACHINE}_usb.zip ${IMAGEDIR}/*; \
	rm -Rf ${IMAGEDIR}; \
	rm -Rf ${IMGDEPLOYDIR}/boot; \
	"
```

## conf/machine/include/spycat-mipsel.inc
```bitbake
TARGET_ARCH = "mipsel"
DEFAULTTUNE = "mips32el"

require conf/machine/include/tune-mips32.inc

MACHINE_KERNEL_PR = "r0"

require conf/machine/include/essential.inc

KERNEL_MODULE_AUTOLOAD += "xfs"

IMAGE_FSTYPES ?= "ubi"
UBI_VOLNAME = "rootfs"
MKUBIFS_ARGS = "-m 2048 -e 126976 -c 4096 -F"
UBINIZE_ARGS = "-m 2048 -p 128KiB"

PREFERRED_PROVIDER_virtual/kernel = "linux-spycat"

# We know about rtc
MACHINE_FEATURES_BACKFILL_CONSIDERED = "rtc"

MACHINE_ESSENTIAL_EXTRA_RDEPENDS = " \
	spycat-dvb-modules-${MACHINE} \
	"

MACHINE_EXTRA_RRECOMMENDS += "gst-plugin-dvbmediasink"

DVBMEDIASINK_CONFIG = "--with-wma --with-wmv --with-pcm --with-dts --with-eac3 \
	${@bb.utils.contains('MACHINE_FEATURES', 'h265', '--with-h265' , '', d)} \
	"

MACHINE_FEATURES += " alsa wlan 3dtv switchoff osdposition hdmicec"

IMAGEDIR ?= "${MACHINE}"
IMGDEPLOYDIR ?= "${DEPLOY_DIR_IMAGE}"
IMAGEVERSION := "${DISTRO_NAME}-${DISTRO_VERSION}-${DATE}"
IMAGEVERSION[vardepsexclude] = "DATE"

IMAGE_CMD_ubi_prepend = " \
	rm -rf ${IMAGE_ROOTFS}/boot/*; \
	rm -rf ${IMAGE_ROOTFS}/tmp/*; \
	"

IMAGE_CMD_ubi_append = " \
	mkdir -p ${IMGDEPLOYDIR}/${IMAGEDIR}; \
	cp -f ${IMGDEPLOYDIR}/${IMAGE_NAME}.rootfs.ubi ${IMGDEPLOYDIR}/${IMAGEDIR}/rootfs.bin; \
	cp -f ${DEPLOY_DIR_IMAGE}/${KERNEL_IMAGETYPE}-${MACHINE}.bin ${IMGDEPLOYDIR}/${IMAGEDIR}/kernel.bin; \
	echo "${IMAGEVERSION}" > ${IMGDEPLOYDIR}/${IMAGEDIR}/imageversion; \
	echo "rename this file to 'force' to force an update without confirmation" > ${IMGDEPLOYDIR}/${IMAGEDIR}/noforce; \
	cd ${IMGDEPLOYDIR}; \
	zip ${DISTRO_NAME}-${DISTRO_VERSION}-${MACHINE}_usb.zip ${IMAGEDIR}/*; \
	rm -rf ${IMAGEDIR}; \
	"
```
